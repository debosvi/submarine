## projects/br2/Config.in
```kconfig
 
source "$BR2_EXTERNAL_SUBMARINE_PATH/package/libcanard/Config.in"
source "$BR2_EXTERNAL_SUBMARINE_PATH/package/test2/Config.in"

config SUBMARINE_FLASH_ADDR
  hex "my-board flash address"
  default 0x10AD
```

## projects/br2/configs/rudder_defconfig
```kconfig
# Architecture
BR2_i386=y
BR2_x86_pentiumpro=y

# System
BR2_SYSTEM_DHCP="eth0"
BR2_TARGET_GENERIC_GETTY_PORT="tty1"

# Filesystem
BR2_TARGET_ROOTFS_EXT2=y
# BR2_TARGET_ROOTFS_TAR is not set

# Linux headers same as kernel, a 4.19 series
BR2_PACKAGE_HOST_LINUX_HEADERS_CUSTOM_4_19=y

# Kernel
BR2_LINUX_KERNEL=y
BR2_LINUX_KERNEL_CUSTOM_VERSION=y
BR2_LINUX_KERNEL_CUSTOM_VERSION_VALUE="4.19.16"
BR2_LINUX_KERNEL_USE_CUSTOM_CONFIG=y
BR2_LINUX_KERNEL_CUSTOM_CONFIG_FILE="$(BR2_EXTERNAL_SUBMARINE_PATH)/board/rudder/linux.config"

# Busybox
BR2_PACKAGE_BUSYBOX_CONFIG="$(BR2_EXTERNAL_SUBMARINE_PATH)/board/rudder/busybox.config"

# Overlay
BR2_ROOTFS_OVERLAY="$(BR2_EXTERNAL_SUBMARINE_PATH)/board/rudder/overlay/"

# SKARNET
BR2_PACKAGE_S6_DNS=y
BR2_PACKAGE_S6_NETWORKING=y
BR2_PACKAGE_S6=y
BR2_PACKAGE_S6_LINUX_INIT=y
BR2_PACKAGE_S6_LINUX_UTILS=y
BR2_PACKAGE_S6_PORTABLE_UTILS=y
BR2_PACKAGE_S6_RC=y

# CAN bus
BR2_PACKAGE_CAN_UTILS=y
BR2_PACKAGE_IPROUTE2=y
```

## projects/br2/package/libcanard/Config.in
```kconfig
 
config BR2_PACKAGE_LIBCANARD
  bool "libcanard"
  help
    Some help about licanard
```
